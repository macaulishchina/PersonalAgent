## src/assistant_runtime/plugins/ai_passport/firmware/apps/pa_terminal/sdkconfig.defaults
```kconfig
CONFIG_IDF_TARGET="esp32c3"
CONFIG_ESPTOOLPY_FLASHSIZE_8MB=y
CONFIG_ESPTOOLPY_HEADER_FLASHSIZE_UPDATE=n
CONFIG_PARTITION_TABLE_CUSTOM=y
CONFIG_PARTITION_TABLE_CUSTOM_FILENAME="partitions.csv"
CONFIG_PARTITION_TABLE_FILENAME="partitions.csv"
CONFIG_ESP_CONSOLE_USB_SERIAL_JTAG=y
CONFIG_ESP_CONSOLE_SECONDARY_NONE=y
CONFIG_LV_COLOR_DEPTH_16=y
CONFIG_LV_DEF_REFR_PERIOD=20
CONFIG_LV_FONT_MONTSERRAT_14=y
CONFIG_LV_MEM_SIZE_KILOBYTES=24
CONFIG_FREERTOS_HZ=1000
CONFIG_ESP_MAIN_TASK_STACK_SIZE=6144
CONFIG_MBEDTLS_SSL_IN_CONTENT_LEN=16384
CONFIG_MBEDTLS_SSL_OUT_CONTENT_LEN=4096
CONFIG_MBEDTLS_DYNAMIC_BUFFER=y
CONFIG_MBEDTLS_SSL_KEEP_PEER_CERTIFICATE=n
CONFIG_MBEDTLS_HAVE_TIME_DATE=y
CONFIG_LITTLEFS_CACHE_SIZE=128
CONFIG_LITTLEFS_LOOKAHEAD_SIZE=16
CONFIG_LITTLEFS_MAX_PARTITIONS=1
CONFIG_LITTLEFS_OBJ_NAME_LEN=96
```

## src/assistant_runtime/plugins/ai_passport/firmware/main/Kconfig.projbuild
```kconfig
menu "PPDemo"
config PPDEMO_LANGUAGE_ZH
    bool "Chinese display and provisioning page"
    default n
    help
        Build PPDemo-Zh with bundled Chinese glyphs. Tests and JSON report keys
        remain shared with the English PPDemo firmware.
endmenu
```
